## components/bsec_bme680/Kconfig
```kconfig
menu "BSEC Configuration"

    config BME680_I2C_ADDR
        hex "BME680 I2C Address"
        range 0x76 0x77
        default 0x77
        help
            I2C address of the BME680 sensor.
            0x77: SDO pin connected to VDD (default)
            0x76: SDO pin connected to GND

endmenu
```

## components/device_server/Kconfig.projbuild
```kconfig
menu "Device Server"
    config DEVICE_SERVER_AUTH_TOKEN
        string "Local HTTP bearer token (64 hexadecimal characters)"
        default ""
        help
            Generate a token with Python: import secrets; print(secrets.token_hex(32)).
            Keep it in local sdkconfig. An empty or invalid token disables the server.
            HTTP is unencrypted; use this service only on a trusted local network.
endmenu
```

## components/stock_monitor/Kconfig
```kconfig
menu "Stock Monitor Configuration"

    config FINNHUB_API_KEY
        string "Finnhub API Key"
        default ""
        help
            API Key for Finnhub.io stock data service.
            Get your free key at https://finnhub.io/
            
endmenu
```
